## Software/Examples_Project/1_Advertisement/main/Kconfig.projbuild
```kconfig
menu "HX Advertisement Example Configuration"

    choice ADV_MODE
        bool " Adv Mode"
        default ADV_SENDER
        help
            Select the Advertisement Mode.

        config ADV_SENDER
            bool "Adv Sender Mode"
            help
                Select the Adv Sender Mode.

        config ADV_RECEIVER
            bool "Adv Receiver Mode"
            help
                Select the Adv Receiver Mode.

    endchoice

    config ADV_MODE
        int
        default 0 if ADV_SENDER
        default 1 if ADV_RECEIVER

endmenu
```
